## package/yad/Config.in
```kconfig
config BR2_PACKAGE_YAD
	bool "yad"
	help
	  YAD (yet another dialog) is a tool for create graphical
	  dialogs from shell scripts.

	  http://sourceforge.net/projects/yad-dialog/
```
