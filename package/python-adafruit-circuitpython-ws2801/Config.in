## package/python-adafruit-circuitpython-ws2801/Config.in
```kconfig
config BR2_PACKAGE_PYTHON_ADAFRUIT_CIRCUITPYTHON_WS2801
	bool "python-adafruit-circuitpython-ws2801"
	help
	  CircuitPython library for WS2801 LEDs.

	  https://pypi.org/project/adafruit-circuitpython-ws2801
```

## package/spirv-llvm-translator/Config.in
```kconfig
config BR2_PACKAGE_SPIRV_LLVM_TRANSLATOR
	bool "spirv-llvm-translator"
	depends on BR2_INSTALL_LIBSTDCPP
	select BR2_PACKAGE_CLANG
	help
	  A tool and a library for bi-directional translation between SPIR-V and LLVM IR

	  https://github.com/KhronosGroup/SPIRV-LLVM-Translator

comment "spirv-llvm-translator needs a toolchain w/ C++"
	depends on !BR2_INSTALL_LIBSTDCPP
```
